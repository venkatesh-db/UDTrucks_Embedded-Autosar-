AUTOSAR XML (schema 4-2-2)
package /EcuC
  ecu instance EngineECU: diagnostic-address=0x10  # Engine Control Unit Configuration
    can communication controller CAN_Controller_0
      init-config-set:
        can controller config CanControllerConfig_0: controller-id=0, default-baud-rate=500000, max-baud-rate=1000000, sync-jump-width=1, prop-seg=2, phase-seg1=5, phase-seg2=2
    function-groups:
      mode declaration group prototype VehicleMode: type=VehicleMode
