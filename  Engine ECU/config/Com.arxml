AUTOSAR XML (schema 4-2-2)
package /Com
  bsw module description Com: module-id=50
    provided-entrys:
      5 x bsw module entry, all with call-type=REGULAR:
        ComInit: service-id=0x01, is-reentrant=false, is-synchronous=true
        ComDeInit: service-id=0x02, is-reentrant=false, is-synchronous=true
        ComIpdGroupControl: service-id=0x03, is-reentrant=false, is-synchronous=true
        ComSendSignal: service-id=0x0a, is-reentrant=true, is-synchronous=false
        ComReceiveSignal: service-id=0x0b, is-reentrant=true, is-synchronous=true
    bsw internal behavior ComBehavior
      bsw schedulable entity ComMainFunctionRx: implemented-entry=ComMainFunctionRx
      bsw schedulable entity ComMainFunctionTx: implemented-entry=ComMainFunctionTx
  com-config config-variant=VARIANT-PRE-COMPILE, com-configuration-id=0, com-configuration-time-base=0.005, com-enable-mdt-for-cyclic-transmission=false, com-version-info-api=false, com-tx-mode-true={com-tx-mode-conditions=data-filter-type=ALWAYS, com-tx-mode-mode=PERIODIC, com-tx-mode-number-of-repetitions=0, com-tx-mode-repetition-period=0.1, com-tx-mode-time-offset=0.01, com-tx-mode-time-period=0.1}:
    com i pdu group EngineDataGroup: com-i-pdu-group-id=0, com-i-pdu-direction=SEND
    com i pdu group VehicleDataGroup: com-i-pdu-group-id=1, com-i-pdu-direction=RECEIVE
    com i pdu ComIPdu_EngineSpeed: com-i-pdu-id=0, com-i-pdu-direction=SEND, com-i-pdu-length=8, com-i-pdu-type=NORMAL, com-tx-i-pdu={com-tx-i-pdu-confirmation-timeout=0.5, com-tx-i-pdu-unused-areas-default=0, com-tx-mode-true=COM-TX-MODE-TRUE}, com-i-pdu-group=EngineDataGroup
    com i pdu ComIPdu_ThrottlePos: com-i-pdu-id=1, com-i-pdu-direction=RECEIVE, com-i-pdu-length=8, com-i-pdu-type=NORMAL, com-rx-i-pdu={com-rx-i-pdu-timeout-action=NONE, com-rx-i-pdu-timeout-timeout=1.0}, com-i-pdu-group=VehicleDataGroup
    com signal ComSignal_EngineSpeed: com-system-template-signal=EngineSpeed, com-signal-endianness=big-endian, com-signal-initial-value=0, com-signal-length=16, com-signal-type=PRIMITIVE, com-transfer-property=PENDING
    com signal ComSignal_ThrottlePosition: com-system-template-signal=ThrottlePosition, com-signal-endianness=big-endian, com-signal-initial-value=0, com-signal-length=16, com-signal-type=PRIMITIVE, com-transfer-property=PENDING
    com i signal i pdu ComISignalIPdu_EngineSpeed: com-i-pdu=ComIPdu_EngineSpeed, com-i-signal=ComSignal_EngineSpeed, com-packing-byte-order=big-endian, com-start-position=0
    com i signal i pdu ComISignalIPdu_ThrottlePos: com-i-pdu=ComIPdu_ThrottlePos, com-i-signal=ComSignal_ThrottlePosition, com-packing-byte-order=big-endian, com-start-position=0
