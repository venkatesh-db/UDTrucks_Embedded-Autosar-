AUTOSAR XML (schema 4-2-2)
package /EcuInstance
  ecu instance EngineECU
    can communication controller CanController_0: can-if-config=init-config-set=can-controller-config{controller-id=0, default-baud-rate=500000, max-baud-rate=1000000}
package /Os
  os OsApplication
    os task StartupTask: priority=10, schedule=FULL, activation=1, autostart=true
    os task MainTask: priority=5, schedule=FULL, activation=1, autostart=false
    os alarm MainTaskAlarm: counter=SystemTimer, action=MainTask, autostart=relative={alarm-time=10, cycle-time=10}
package /Rte
  rte event StartupEvent: start-on-event=StartupRunnable
