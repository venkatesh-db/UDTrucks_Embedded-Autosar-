AUTOSAR XML (schema 4-2-2)
package /CanIf
  bsw module description CanIf: module-id=60
    provided-entrys:
      4 x bsw module entry, all with call-type=REGULAR:
        CanIfInit: service-id=0x01, is-reentrant=false, is-synchronous=true
        CanIfDeInit: service-id=0x02, is-reentrant=false, is-synchronous=true
        CanIfSetControllerMode: service-id=0x03, is-reentrant=false, is-synchronous=false
        CanIfTransmit: service-id=0x49, is-reentrant=true, is-synchronous=false
    bsw internal behavior CanIfBehavior
      bsw schedulable entity CanIfMainFunction: implemented-entry=CanIfMainFunction
  can-if-config config-variant=VARIANT-PRE-COMPILE:
    can-if-init-configuration:
      can if controller config CanIfController_0: can-if-ctrl-id=0, can-if-ctrl-can-ctrl=CanControllerConfig_0, can-if-ctrl-wakeup-support=false
      can if hth config CanIfHTH_EngineSpeed: can-if-hth-id-sym=0x100, can-if-hth-can-ctrl-id=CanIfController_0, can-object-type=TRANSMIT
      can if hth config CanIfHTH_EngineTemp: can-if-hth-id-sym=0x101, can-if-hth-can-ctrl-id=CanIfController_0, can-object-type=TRANSMIT
      can if hrh config CanIfHRH_ThrottlePos: can-if-hrh-id-sym=0x200, can-if-hrh-can-ctrl-id=CanIfController_0, can-object-type=RECEIVE, can-if-software-filter-hrh=true
      can if hrh config CanIfHRH_BrakeStatus: can-if-hrh-id-sym=0x201, can-if-hrh-can-ctrl-id=CanIfController_0, can-object-type=RECEIVE, can-if-software-filter-hrh=true
      can if tx pdu config CanIfTxPdu_EngineSpeed: can-if-tx-pdu-id=0, can-if-tx-pdu-can-id=0x100, can-if-tx-pdu-can-id-type=STANDARD, can-if-tx-pdu-dlc=8, can-if-tx-pdu-hth=CanIfHTH_EngineSpeed, can-if-tx-pdu-trigger-transmit=false, can-if-tx-pdu-tx-confirmation=true
      can if tx pdu config CanIfTxPdu_EngineTemp: can-if-tx-pdu-id=1, can-if-tx-pdu-can-id=0x101, can-if-tx-pdu-can-id-type=STANDARD, can-if-tx-pdu-dlc=8, can-if-tx-pdu-hth=CanIfHTH_EngineTemp, can-if-tx-pdu-trigger-transmit=false, can-if-tx-pdu-tx-confirmation=true
      can if rx pdu config CanIfRxPdu_ThrottlePos: can-if-rx-pdu-id=0, can-if-rx-pdu-can-id=0x200, can-if-rx-pdu-can-id-type=STANDARD, can-if-rx-pdu-dlc=8, can-if-rx-pdu-hrh-id=CanIfHRH_ThrottlePos, can-if-rx-pdu-read-notify-status=true
      can if rx pdu config CanIfRxPdu_BrakeStatus: can-if-rx-pdu-id=1, can-if-rx-pdu-can-id=0x201, can-if-rx-pdu-can-id-type=STANDARD, can-if-rx-pdu-dlc=8, can-if-rx-pdu-hrh-id=CanIfHRH_BrakeStatus, can-if-rx-pdu-read-notify-status=true
