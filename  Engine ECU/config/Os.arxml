AUTOSAR XML (schema 4-2-2)
package /Os
  os EngineECU_OS: cc=ECC1, status=EXTENDED, usegetserviceid=true, useparameteraccess=true, useresscheduler=true  # Operating System Configuration for Engine ECU
    4 x os task, all with schedule=FULL, activation=1:
      StartupTask: priority=15, autostart=true, stack-size=2048, event-mask=0
      MainTask_10ms: priority=10, autostart=false, stack-size=4096
      MainTask_100ms: priority=5, autostart=false, stack-size=3072
      BackgroundTask: priority=1, autostart=false, stack-size=2048
    os counter SystemTimer: max-allowed-value=65535, ticks-per-base=1, min-cycle=1, type=HARDWARE, unit=NANOSECONDS, seconds-per-tick=0.000001
    os alarm Alarm_10ms: counter=SystemTimer, action=MainTask_10ms, autostart=relative={alarm-time=10000, cycle-time=10000}
    os alarm Alarm_100ms: counter=SystemTimer, action=MainTask_100ms, autostart=relative={alarm-time=100000, cycle-time=100000}
    os resource RES_SCHEDULER: resource-property=STANDARD
    os resource SharedResource: resource-property=STANDARD
    os isr SystemTimerISR: category=2, priority=20, stack-size=512
    os isr CAN_RX_ISR: category=2, priority=18, stack-size=1024
